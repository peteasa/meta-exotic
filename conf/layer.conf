## conf/layer.conf
```bitbake
##################################################################
# The rather bold intention of this layer is to provide an easy
# way to prove updates to poky/meta/classes and poky/meta/conf
#
##################################################################

# We have a conf and classes directory, add to BBPATH
BBPATH := "${BBPATH}:${LAYERDIR}"

# add packages directories to BBFILES
#BBFILES := "${BBFILES} ${LAYERDIR}/recipes-*/*/*.bb"
#BBFILES += " ${LAYERDIR}/recipes-*/*/*.bbappend"
# ignore empty package directories
BBFILE_PATTERN_IGNORE_EMPTY_exotic = "1"

BBFILE_COLLECTIONS += "exotic"
BBFILE_PATTERN_exotic := "^${LAYERDIR}/"
BBFILE_PRIORITY_exotic = "6"
```
